## build-nordic-dk/Kconfig/arch/Kconfig
```kconfig
# Load Zephyr Arch Kconfig descriptions.
osource "/home/mike/Desktop/zephyr-main/zephyr/arch/rx/Kconfig"
osource "/home/mike/Desktop/zephyr-main/zephyr/arch/x86/Kconfig"
osource "/home/mike/Desktop/zephyr-main/zephyr/arch/xtensa/Kconfig"
osource "/home/mike/Desktop/zephyr-main/zephyr/arch/sparc/Kconfig"
osource "/home/mike/Desktop/zephyr-main/zephyr/arch/riscv/Kconfig"
osource "/home/mike/Desktop/zephyr-main/zephyr/arch/posix/Kconfig"
osource "/home/mike/Desktop/zephyr-main/zephyr/arch/openrisc/Kconfig"
osource "/home/mike/Desktop/zephyr-main/zephyr/arch/mips/Kconfig"
osource "/home/mike/Desktop/zephyr-main/zephyr/arch/arm64/Kconfig"
osource "/home/mike/Desktop/zephyr-main/zephyr/arch/arm/Kconfig"
osource "/home/mike/Desktop/zephyr-main/zephyr/arch/arc/Kconfig"
```

## build-nordic-dk/Kconfig/boards/Kconfig.defconfig.tmp
```kconfig
# Load Zephyr board defconfig descriptions.
osource "/home/mike/Desktop/zephyr-main/zephyr/boards/nordic/nrf54l15dk/Kconfig.defconfig"
```

## build-nordic-dk/Kconfig/boards/Kconfig.sysbuild
```kconfig
# Load Sysbuild board Kconfig descriptions.
osource "/home/mike/Desktop/zephyr-main/zephyr/boards/nordic/nrf54l15dk/Kconfig.sysbuild"
```

## build-nordic-dk/Kconfig/soc/Kconfig.defconfig.tmp
```kconfig
# Load Zephyr SoC defconfig descriptions.
osource "/home/mike/Desktop/zephyr-main/zephyr/soc/xlnx/zynqmp/Kconfig.defconfig"
osource "/home/mike/Desktop/zephyr-main/zephyr/soc/xlnx/zynq7000/Kconfig.defconfig"
osource "/home/mike/Desktop/zephyr-main/zephyr/soc/xlnx/versalnet/Kconfig.defconfig"
osource "/home/mike/Desktop/zephyr-main/zephyr/soc/xlnx/versal2/Kconfig.defconfig"
osource "/home/mike/Desktop/zephyr-main/zephyr/soc/xlnx/versal/Kconfig.defconfig"
osource "/home/mike/Desktop/zephyr-main/zephyr/soc/xen/Kconfig.defconfig"
osource "/home/mike/Desktop/zephyr-main/zephyr/soc/wch/ch32v/Kconfig.defconfig"
osource "/home/mike/Desktop/zephyr-main/zephyr/soc/ti/simplelink/Kconfig.defconfig"
osource "/home/mike/Desktop/zephyr-main/zephyr/soc/ti/mspm0/Kconfig.defconfig"
osource "/home/mike/Desktop/zephyr-main/zephyr/soc/ti/lm3s6965/Kconfig.defconfig"
osource "/home/mike/Desktop/zephyr-main/zephyr/soc/ti/k3/Kconfig.defconfig"
osource "/home/mike/Desktop/zephyr-main/zephyr/soc/telink/tlsr/Kconfig.defconfig"
osource "/home/mike/Desktop/zephyr-main/zephyr/soc/syna/sr100/Kconfig.defconfig"
osource "/home/mike/Desktop/zephyr-main/zephyr/soc/starfive/jh71xx/Kconfig.defconfig"
osource "/home/mike/Desktop/zephyr-main/zephyr/soc/st/stm32/Kconfig.defconfig"
osource "/home/mike/Desktop/zephyr-main/zephyr/soc/snps/qemu_arc/Kconfig.defconfig"
osource "/home/mike/Desktop/zephyr-main/zephyr/soc/snps/nsim/arc_v/Kconfig.defconfig"
osource "/home/mike/Desktop/zephyr-main/zephyr/soc/snps/nsim/arc_classic/Kconfig.defconfig"
osource "/home/mike/Desktop/zephyr-main/zephyr/soc/snps/hsdk4xd/Kconfig.defconfig"
osource "/home/mike/Desktop/zephyr-main/zephyr/soc/snps/hsdk/Kconfig.defconfig"
osource "/home/mike/Desktop/zephyr-main/zephyr/soc/snps/emsk/Kconfig.defconfig"
osource "/home/mike/Desktop/zephyr-main/zephyr/soc/snps/emsdp/Kconfig.defconfig"
osource "/home/mike/Desktop/zephyr-main/zephyr/soc/snps/arc_iot/Kconfig.defconfig"
osource "/home/mike/Desktop/zephyr-main/zephyr/soc/silabs/Kconfig.defconfig"
osource "/home/mike/Desktop/zephyr-main/zephyr/soc/sifli/sf32/Kconfig.defconfig"
osource "/home/mike/Desktop/zephyr-main/zephyr/soc/sifive/sifive_freedom/Kconfig.defconfig"
osource "/home/mike/Desktop/zephyr-main/zephyr/soc/sensry/Kconfig.defconfig"
osource "/home/mike/Desktop/zephyr-main/zephyr/soc/rockchip/Kconfig.defconfig"
osource "/home/mike/Desktop/zephyr-main/zephyr/soc/renode/riscv_virtual/Kconfig.defconfig"
osource "/home/mike/Desktop/zephyr-main/zephyr/soc/renode/cortex_r8_virtual/Kconfig.defconfig"
osource "/home/mike/Desktop/zephyr-main/zephyr/soc/renesas/smartbond/Kconfig.defconfig"
osource "/home/mike/Desktop/zephyr-main/zephyr/soc/renesas/rz/Kconfig.defconfig"
osource "/home/mike/Desktop/zephyr-main/zephyr/soc/renesas/rx/Kconfig.defconfig"
osource "/home/mike/Desktop/zephyr-main/zephyr/soc/renesas/rcar/Kconfig.defconfig"
osource "/home/mike/Desktop/zephyr-main/zephyr/soc/renesas/ra/Kconfig.defconfig"
osource "/home/mike/Desktop/zephyr-main/zephyr/soc/realtek/fingerprint/Kconfig.defconfig"
osource "/home/mike/Desktop/zephyr-main/zephyr/soc/realtek/ec/Kconfig.defconfig"
osource "/home/mike/Desktop/zephyr-main/zephyr/soc/realtek/bee/Kconfig.defconfig"
osource "/home/mike/Desktop/zephyr-main/zephyr/soc/realtek/ameba/Kconfig.defconfig"
osource "/home/mike/Desktop/zephyr-main/zephyr/soc/raspberrypi/rpi_pico/Kconfig.defconfig"
osource "/home/mike/Desktop/zephyr-main/zephyr/soc/quicklogic/eos_s3/Kconfig.defconfig"
osource "/home/mike/Desktop/zephyr-main/zephyr/soc/qemu/virt_riscv/Kconfig.defconfig"
osource "/home/mike/Desktop/zephyr-main/zephyr/soc/qemu/or1k/Kconfig.defconfig"
osource "/home/mike/Desktop/zephyr-main/zephyr/soc/qemu/malta/Kconfig.defconfig"
osource "/home/mike/Desktop/zephyr-main/zephyr/soc/openisa/rv32m1/Kconfig.defconfig"
osource "/home/mike/Desktop/zephyr-main/zephyr/soc/openhwgroup/cva6/Kconfig.defconfig"
osource "/home/mike/Desktop/zephyr-main/zephyr/soc/oct/osd32mp15x/Kconfig.defconfig"
osource "/home/mike/Desktop/zephyr-main/zephyr/soc/nxp/s32/Kconfig.defconfig"
osource "/home/mike/Desktop/zephyr-main/zephyr/soc/nxp/rw/Kconfig.defconfig"
osource "/home/mike/Desktop/zephyr-main/zephyr/soc/nxp/mcx/Kconfig.defconfig"
osource "/home/mike/Desktop/zephyr-main/zephyr/soc/nxp/lpc/Kconfig.defconfig"
osource "/home/mike/Desktop/zephyr-main/zephyr/soc/nxp/layerscape/Kconfig.defconfig"
osource "/home/mike/Desktop/zephyr-main/zephyr/soc/nxp/kinetis/Kconfig.defconfig"
osource "/home/mike/Desktop/zephyr-main/zephyr/soc/nxp/imxrt/Kconfig.defconfig"
osource "/home/mike/Desktop/zephyr-main/zephyr/soc/nxp/imx/Kconfig.defconfig"
osource "/home/mike/Desktop/zephyr-main/zephyr/soc/nuvoton/numicro/Kconfig.defconfig"
osource "/home/mike/Desktop/zephyr-main/zephyr/soc/nuvoton/numaker/Kconfig.defconfig"
osource "/home/mike/Desktop/zephyr-main/zephyr/soc/nuvoton/npcx/Kconfig.defconfig"
osource "/home/mike/Desktop/zephyr-main/zephyr/soc/nuvoton/npcm/Kconfig.defconfig"
osource "/home/mike/Desktop/zephyr-main/zephyr/soc/nordic/Kconfig.defconfig"
osource "/home/mike/Desktop/zephyr-main/zephyr/soc/neorv32/Kconfig.defconfig"
osource "/home/mike/Desktop/zephyr-main/zephyr/soc/native/inf_clock/Kconfig.defconfig"
osource "/home/mike/Desktop/zephyr-main/zephyr/soc/microchip/sam/sama7/Kconfig.defconfig"
osource "/home/mike/Desktop/zephyr-main/zephyr/soc/microchip/sam/sam_d5x_e5x/Kconfig.defconfig"
osource "/home/mike/Desktop/zephyr-main/zephyr/soc/microchip/pic64/Kconfig.defconfig"
osource "/home/mike/Desktop/zephyr-main/zephyr/soc/microchip/pic32c/pic32cz_ca/Kconfig.defconfig"
osource "/home/mike/Desktop/zephyr-main/zephyr/soc/microchip/pic32c/pic32cx_sg/Kconfig.defconfig"
osource "/home/mike/Desktop/zephyr-main/zephyr/soc/microchip/pic32c/pic32cm_pl/Kconfig.defconfig"
osource "/home/mike/Desktop/zephyr-main/zephyr/soc/microchip/pic32c/pic32cm_jh/Kconfig.defconfig"
osource "/home/mike/Desktop/zephyr-main/zephyr/soc/microchip/miv/Kconfig.defconfig"
osource "/home/mike/Desktop/zephyr-main/zephyr/soc/microchip/mec/Kconfig.defconfig"
osource "/home/mike/Desktop/zephyr-main/zephyr/soc/mediatek/mt8xxx/Kconfig.defconfig"
osource "/home/mike/Desktop/zephyr-main/zephyr/soc/lowrisc/opentitan/Kconfig.defconfig"
osource "/home/mike/Desktop/zephyr-main/zephyr/soc/litex/Kconfig.defconfig"
osource "/home/mike/Desktop/zephyr-main/zephyr/soc/ite/ec/Kconfig.defconfig"
osource "/home/mike/Desktop/zephyr-main/zephyr/soc/intel/wildcat_lake/Kconfig.defconfig"
osource "/home/mike/Desktop/zephyr-main/zephyr/soc/intel/raptor_lake/Kconfig.defconfig"
osource "/home/mike/Desktop/zephyr-main/zephyr/soc/intel/panther_lake/Kconfig.defconfig"
osource "/home/mike/Desktop/zephyr-main/zephyr/soc/intel/lakemont/Kconfig.defconfig"
osource "/home/mike/Desktop/zephyr-main/zephyr/soc/intel/intel_socfpga_std/Kconfig.defconfig"
osource "/home/mike/Desktop/zephyr-main/zephyr/soc/intel/intel_socfpga/Kconfig.defconfig"
osource "/home/mike/Desktop/zephyr-main/zephyr/soc/intel/intel_niosv/Kconfig.defconfig"
osource "/home/mike/Desktop/zephyr-main/zephyr/soc/intel/intel_ish/Kconfig.defconfig"
osource "/home/mike/Desktop/zephyr-main/zephyr/soc/intel/intel_adsp/Kconfig.defconfig"
osource "/home/mike/Desktop/zephyr-main/zephyr/soc/intel/elkhart_lake/Kconfig.defconfig"
osource "/home/mike/Desktop/zephyr-main/zephyr/soc/intel/atom/Kconfig.defconfig"
osource "/home/mike/Desktop/zephyr-main/zephyr/soc/intel/apollo_lake/Kconfig.defconfig"
osource "/home/mike/Desktop/zephyr-main/zephyr/soc/intel/alder_lake/Kconfig.defconfig"
osource "/home/mike/Desktop/zephyr-main/zephyr/soc/infineon/psoc4/Kconfig.defconfig"
osource "/home/mike/Desktop/zephyr-main/zephyr/soc/infineon/edge/Kconfig.defconfig"
osource "/home/mike/Desktop/zephyr-main/zephyr/soc/infineon/cat3/Kconfig.defconfig"
osource "/home/mike/Desktop/zephyr-main/zephyr/soc/infineon/cat1c/Kconfig.defconfig"
osource "/home/mike/Desktop/zephyr-main/zephyr/soc/infineon/cat1b/Kconfig.defconfig"
osource "/home/mike/Desktop/zephyr-main/zephyr/soc/infineon/cat1a/Kconfig.defconfig"
osource "/home/mike/Desktop/zephyr-main/zephyr/soc/gd/gd32/Kconfig.defconfig"
osource "/home/mike/Desktop/zephyr-main/zephyr/soc/gaisler/leon3/Kconfig.defconfig"
osource "/home/mike/Desktop/zephyr-main/zephyr/soc/gaisler/gr716a/Kconfig.defconfig"
osource "/home/mike/Desktop/zephyr-main/zephyr/soc/focaltech/Kconfig.defconfig"
osource "/home/mike/Desktop/zephyr-main/zephyr/soc/espressif/Kconfig.defconfig"
osource "/home/mike/Desktop/zephyr-main/zephyr/soc/ene/kb1200/Kconfig.defconfig"
osource "/home/mike/Desktop/zephyr-main/zephyr/soc/ene/kb106x/Kconfig.defconfig"
osource "/home/mike/Desktop/zephyr-main/zephyr/soc/elan/em32f967/Kconfig.defconfig"
osource "/home/mike/Desktop/zephyr-main/zephyr/soc/egis/Kconfig.defconfig"
osource "/home/mike/Desktop/zephyr-main/zephyr/soc/efinix/sapphire/Kconfig.defconfig"
osource "/home/mike/Desktop/zephyr-main/zephyr/soc/cdns/xtensa_sample_controller/Kconfig.defconfig"
osource "/home/mike/Desktop/zephyr-main/zephyr/soc/cdns/swerv/Kconfig.defconfig"
osource "/home/mike/Desktop/zephyr-main/zephyr/soc/cdns/sample_controller32/Kconfig.defconfig"
osource "/home/mike/Desktop/zephyr-main/zephyr/soc/cdns/dc233c/Kconfig.defconfig"
osource "/home/mike/Desktop/zephyr-main/zephyr/soc/brcm/bcmvk/Kconfig.defconfig"
osource "/home/mike/Desktop/zephyr-main/zephyr/soc/brcm/bcm2712/Kconfig.defconfig"
osource "/home/mike/Desktop/zephyr-main/zephyr/soc/brcm/bcm2711/Kconfig.defconfig"
osource "/home/mike/Desktop/zephyr-main/zephyr/soc/blackberry/qnxhv_vm/Kconfig.defconfig"
osource "/home/mike/Desktop/zephyr-main/zephyr/soc/bflb/Kconfig.defconfig"
osource "/home/mike/Desktop/zephyr-main/zephyr/soc/atmel/sam0/Kconfig.defconfig"
osource "/home/mike/Desktop/zephyr-main/zephyr/soc/atmel/sam/Kconfig.defconfig"
osource "/home/mike/Desktop/zephyr-main/zephyr/soc/aspeed/Kconfig.defconfig"
osource "/home/mike/Desktop/zephyr-main/zephyr/soc/arm/Kconfig.defconfig"
osource "/home/mike/Desktop/zephyr-main/zephyr/soc/arm/beetle/Kconfig.defconfig"
osource "/home/mike/Desktop/zephyr-main/zephyr/soc/antmicro/myra/Kconfig.defconfig"
osource "/home/mike/Desktop/zephyr-main/zephyr/soc/andestech/Kconfig.defconfig"
osource "/home/mike/Desktop/zephyr-main/zephyr/soc/amd/acp_7_0/Kconfig.defconfig"
osource "/home/mike/Desktop/zephyr-main/zephyr/soc/amd/acp_6_0/Kconfig.defconfig"
osource "/home/mike/Desktop/zephyr-main/zephyr/soc/ambiq/Kconfig.defconfig"
osource "/home/mike/Desktop/zephyr-main/zephyr/soc/allwinner/sun8i_h3/Kconfig.defconfig"
osource "/home/mike/Desktop/zephyr-main/zephyr/soc/alif/ensemble/Kconfig.defconfig"
osource "/home/mike/Desktop/zephyr-main/zephyr/soc/alif/balletto/Kconfig.defconfig"
osource "/home/mike/Desktop/zephyr-main/zephyr/soc/aesc/Kconfig.defconfig"
osource "/home/mike/Desktop/zephyr-main/zephyr/soc/adi/max32/Kconfig.defconfig"
```

## ports/zephyr/Kconfig
```kconfig
# SPDX-License-Identifier: Apache-2.0

menu "RS Nexus BLE Gateway"

endmenu

source "Kconfig.zephyr"
```
